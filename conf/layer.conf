## conf/layer.conf
```bitbake
# We have a conf and classes directory, add to BBPATH
BBPATH .= ":${LAYERDIR}"

# We have recipes-* directories, add to BBFILES
BBFILES += "${LAYERDIR}/recipes-*/*/*.bb \
            ${LAYERDIR}/recipes-*/*/*.bbappend"

BBFILE_COLLECTIONS += "meta-rafal-new"
BBFILE_PATTERN_meta-rafal-new = "^${LAYERDIR}/"
BBFILE_PRIORITY_meta-rafal-new = "6"

LAYERDEPENDS_meta-rafal-new = "core"
LAYERSERIES_COMPAT_meta-rafal-new = "kirkstone"
```
